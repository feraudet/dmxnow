// Native tests of firmware/common (SPEC 8.3). Packet vectors come from
// test_vectors.json, generated by an independent Python implementation.
#include <ArduinoJson.h>
#include <unity.h>

#include <cstring>
#include <fstream>
#include <sstream>
#include <string>
#include <vector>

#include "dmxnow/auth.h"
#include "dmxnow/cobs.h"
#include "dmxnow/config.h"
#include "dmxnow/crc16.h"
#include "dmxnow/dmx.h"
#include "dmxnow/gamma.h"
#include "dmxnow/protocol.h"
#include "dmxnow/relay.h"

using namespace dmxnow;

static JsonDocument V;

static std::vector<uint8_t> hex(const char* s) {
    std::vector<uint8_t> out;
    for (size_t i = 0; s[i] && s[i + 1]; i += 2) {
        auto nib = [](char c) { return uint8_t(c <= '9' ? c - '0' : (c | 0x20) - 'a' + 10); };
        out.push_back(uint8_t(nib(s[i]) << 4 | nib(s[i + 1])));
    }
    return out;
}

static JsonObject vec(const char* group, const char* name) {
    for (JsonObject o : V[group].as<JsonArray>())
        if (std::strcmp(o["name"] | "", name) == 0) return o;
    TEST_FAIL_MESSAGE(name);
    return JsonObject();
}

void setUp() {}
void tearDown() {}

// --- CRC -------------------------------------------------------------------------
void test_crc_check_value() {
    const char* s = "123456789";
    TEST_ASSERT_EQUAL_HEX16(0x29B1, crc16(reinterpret_cast<const uint8_t*>(s), 9));
    for (JsonObject o : V["crc"].as<JsonArray>()) {
        std::vector<uint8_t> d;
        if (o["ascii"].is<const char*>()) {
            const char* a = o["ascii"];
            d.assign(a, a + std::strlen(a));
        } else {
            d = hex(o["hex"]);
        }
        TEST_ASSERT_EQUAL_HEX16(o["crc"].as<uint16_t>(), crc16(d.data(), d.size()));
    }
}

// --- Header codec, validation --------------------------------------------------
void test_valid_packets_decode() {
    for (JsonObject o : V["valid"].as<JsonArray>()) {
        auto p = hex(o["hex"]);
        Header h;
        Reject r = validate(p.data(), p.size(), o["my_net_id"].as<uint16_t>(), &h);
        TEST_ASSERT_EQUAL_STRING_MESSAGE("ok", reject_name(r), o["name"]);
        TEST_ASSERT_EQUAL_UINT8(o["type"].as<uint8_t>(), h.type);
        TEST_ASSERT_EQUAL_UINT16(o["universe"].as<uint16_t>(), h.universe);
        TEST_ASSERT_EQUAL_UINT16(o["seq"].as<uint16_t>(), h.seq);
        TEST_ASSERT_EQUAL_UINT16(o["offset"].as<uint16_t>(), h.offset);
        TEST_ASSERT_EQUAL_UINT16(o["length"].as<uint16_t>(), h.length);
        TEST_ASSERT_EQUAL_UINT8(o["flags"].as<uint8_t>(), h.flags);
        auto pl = hex(o["payload"]);
        TEST_ASSERT_EQUAL_MEMORY(pl.data(), p.data() + kHeaderSize, pl.size());
    }
}

void test_invalid_packets_rejected_in_order() {
    for (JsonObject o : V["invalid"].as<JsonArray>()) {
        auto p = hex(o["hex"]);
        Reject r = validate(p.data(), p.size(), o["my_net_id"].as<uint16_t>());
        TEST_ASSERT_EQUAL_STRING_MESSAGE(o["reject"].as<const char*>(), reject_name(r), o["name"]);
    }
}

void test_build_packet_matches_vectors() {
    JsonObject o = vec("valid", "dmx_v2");
    auto want = hex(o["hex"]);
    auto pl = hex(o["payload"]);
    Header h;
    h.type = uint8_t(MsgType::DmxData);
    h.net_id = V["net_id"];
    h.universe = o["universe"];
    h.seq = o["seq"];
    h.flags = flags::kLast;
    uint8_t buf[600];
    size_t n = build_packet(h, pl.data(), pl.size(), nullptr, buf, sizeof buf);
    TEST_ASSERT_EQUAL(want.size(), n);
    TEST_ASSERT_EQUAL_MEMORY(want.data(), buf, n);
    TEST_ASSERT_EQUAL(0u, build_packet(h, pl.data(), pl.size(), nullptr, buf, 20));   // does not fit
}

void test_unconfigured_node_accepts_command_and_beacon_only() {
    JsonObject c = vec("valid", "cmd_set_config_unconfigured");
    auto p = hex(c["hex"]);
    TEST_ASSERT_EQUAL_STRING("ok", reject_name(validate(p.data(), p.size(), 0)));
    auto b = hex(vec("valid", "beacon")["hex"]);
    TEST_ASSERT_EQUAL_STRING("ok", reject_name(validate(b.data(), b.size(), 0)));
    auto d = hex(vec("valid", "dmx_v2")["hex"]);
    TEST_ASSERT_EQUAL_STRING("net_id", reject_name(validate(d.data(), d.size(), 0)));
    // a configured node ignores the other network's command
    TEST_ASSERT_EQUAL_STRING("net_id", reject_name(validate(p.data(), p.size(), V["net_id"])));
}

// --- Payload codecs ----------------------------------------------------------------
void test_heartbeat_codec() {
    JsonObject o = vec("valid", "heartbeat");
    auto pl = hex(o["payload"]);
    Heartbeat hb;
    TEST_ASSERT_TRUE(decode_heartbeat(pl.data(), pl.size(), &hb));
    JsonObject e = o["heartbeat"];
    TEST_ASSERT_EQUAL_MEMORY(hex(e["mac"]).data(), hb.mac, 6);
    TEST_ASSERT_EQUAL_STRING(e["name"].as<const char*>(), std::string(hb.name, strnlen(hb.name, 16)).c_str());
    TEST_ASSERT_EQUAL_UINT16(e["start_address"].as<uint16_t>(), hb.start_address);
    TEST_ASSERT_EQUAL_UINT8(e["variant"].as<uint8_t>(), hb.variant);
    TEST_ASSERT_EQUAL_UINT32(e["relay_switch_count"].as<uint32_t>(), hb.relay_switch_count);
    TEST_ASSERT_EQUAL_INT8(e["rssi"].as<int8_t>(), hb.rssi);
    TEST_ASSERT_EQUAL_UINT32(e["lost_frames"].as<uint32_t>(), hb.lost_frames);
    TEST_ASSERT_EQUAL_UINT32(e["uptime_s"].as<uint32_t>(), hb.uptime_s);
    TEST_ASSERT_EQUAL_UINT16(e["dmx_out_slots"].as<uint16_t>(), hb.dmx_out_slots);
    uint8_t back[kHeartbeatPayload];
    encode_heartbeat(hb, back);
    TEST_ASSERT_EQUAL_MEMORY(pl.data(), back, kHeartbeatPayload);
    TEST_ASSERT_FALSE(decode_heartbeat(pl.data(), 55, &hb));
}

void test_beacon_and_command_codec() {
    auto bp = hex(vec("valid", "beacon")["payload"]);
    Beacon b;
    TEST_ASSERT_TRUE(decode_beacon(bp.data(), bp.size(), &b));
    TEST_ASSERT_EQUAL_UINT8(2, b.active_universes);
    TEST_ASSERT_EQUAL_UINT32(3600, b.uptime_s);
    uint8_t back[kBeaconPayload];
    encode_beacon(b, back);
    TEST_ASSERT_EQUAL_MEMORY(bp.data(), back, kBeaconPayload);

    JsonObject c = vec("valid", "cmd_identify_broadcast");
    auto cp = hex(c["payload"]);
    CommandView cv;
    TEST_ASSERT_TRUE(parse_command(cp.data(), cp.size(), &cv));
    TEST_ASSERT_TRUE(mac_is_broadcast(cv.target));
    TEST_ASSERT_EQUAL_UINT8(uint8_t(Opcode::Identify), cv.opcode);
    TEST_ASSERT_EQUAL(2u, cv.args_len);
    TEST_ASSERT_EQUAL_UINT16(10, get16(cv.args));
    TEST_ASSERT_FALSE(parse_command(cp.data(), 6, &cv));
}

// --- Authentication ------------------------------------------------------------------
void test_sha256_and_hmac_vectors() {
    for (JsonObject o : V["sha256"].as<JsonArray>()) {
        auto d = hex(o["data"]);
        Sha256 s;
        s.update(d.data(), d.size());
        uint8_t out[32];
        s.finish(out);
        TEST_ASSERT_EQUAL_MEMORY(hex(o["hash"]).data(), out, 32);
    }
    for (JsonObject o : V["hmac_sha256"].as<JsonArray>()) {
        auto k = hex(o["key"]), d = hex(o["data"]);
        const uint8_t* parts[1] = {d.data()};
        size_t lens[1] = {d.size()};
        uint8_t out[32];
        hmac_sha256(k.data(), k.size(), parts, lens, 1, out);
        TEST_ASSERT_EQUAL_MEMORY(hex(o["mac"]).data(), out, 32);
    }
}

void test_command_auth() {
    auto key = hex(V["net_key"]);
    JsonObject o = vec("valid", "cmd_relay_auth");
    auto p = hex(o["hex"]);
    uint32_t counter = 0;
    TEST_ASSERT_EQUAL(int(AuthResult::Ok), int(auth_check(key.data(), p.data(), p.size(), 41, &counter)));
    TEST_ASSERT_EQUAL_UINT32(42, counter);
    TEST_ASSERT_EQUAL(int(AuthResult::Replay), int(auth_check(key.data(), p.data(), p.size(), 42, nullptr)));
    auto bad = p;
    bad[bad.size() - 1] ^= 1;
    TEST_ASSERT_EQUAL(int(AuthResult::BadMac), int(auth_check(key.data(), bad.data(), bad.size(), 0, nullptr)));
    auto wrong_key = key;
    wrong_key[0] ^= 1;
    TEST_ASSERT_EQUAL(int(AuthResult::BadMac), int(auth_check(wrong_key.data(), p.data(), p.size(), 0, nullptr)));
    auto plain = hex(vec("valid", "cmd_identify_broadcast")["hex"]);
    TEST_ASSERT_EQUAL(int(AuthResult::Missing), int(auth_check(key.data(), plain.data(), plain.size(), 0, nullptr)));
    // the trailer computed here equals the Python one
    auto pl = hex(o["payload"]);
    uint8_t tr[kAuthSize];
    auth_trailer(key.data(), p.data(), pl.data(), pl.size(), 42, tr);
    TEST_ASSERT_EQUAL_MEMORY(p.data() + kHeaderSize + pl.size(), tr, kAuthSize);
}

void test_command_history_idempotence() {
    CommandHistory h;
    size_t len = 0;
    TEST_ASSERT_NULL(h.find(7, &len));
    uint8_t ack[3] = {4, 0, 1};
    h.remember(7, ack, 3);
    const uint8_t* got = h.find(7, &len);
    TEST_ASSERT_NOT_NULL(got);
    TEST_ASSERT_EQUAL(3u, len);
    TEST_ASSERT_EQUAL_MEMORY(ack, got, 3);
    for (uint16_t i = 100; i < 116; ++i) h.remember(i, ack, 1);   // 16 newer entries
    TEST_ASSERT_NULL(h.find(7, &len));
    TEST_ASSERT_NOT_NULL(h.find(115, &len));
}

// --- COBS ------------------------------------------------------------------------------
void test_cobs_vectors() {
    for (JsonObject o : V["cobs"].as<JsonArray>()) {
        auto raw = hex(o["raw"]), enc = hex(o["enc"]);
        std::vector<uint8_t> out(cobs_max_encoded(raw.size()));
        size_t n = cobs_encode(raw.data(), raw.size(), out.data(), out.size());
        TEST_ASSERT_EQUAL(enc.size(), n);
        TEST_ASSERT_EQUAL_MEMORY(enc.data(), out.data(), n);
        for (size_t i = 0; i < n; ++i) TEST_ASSERT_NOT_EQUAL(0, out[i]);
        std::vector<uint8_t> dec(raw.size() + 1);
        long m = cobs_decode(enc.data(), enc.size(), dec.data(), dec.size());
        TEST_ASSERT_EQUAL(long(raw.size()), m);
        if (m) TEST_ASSERT_EQUAL_MEMORY(raw.data(), dec.data(), raw.size());
    }
    uint8_t out[16];
    const uint8_t with_zero[] = {2, 0, 1};
    TEST_ASSERT_EQUAL(-1, cobs_decode(with_zero, 3, out, sizeof out));
    const uint8_t truncated[] = {5, 1, 2};
    TEST_ASSERT_EQUAL(-1, cobs_decode(truncated, 3, out, sizeof out));
}

// --- TLV configuration ----------------------------------------------------------------
static const uint8_t kMac[6] = {0x24, 0x0A, 0xC4, 0x12, 0x34, 0x56};

void test_config_defaults_serialize_like_python() {
    NodeConfig c = default_config(kMac);
    TEST_ASSERT_EQUAL_STRING("node-123456", c.name);
    uint8_t buf[200];
    size_t n = serialize_config_tlv(c, buf, sizeof buf);
    auto want = hex(V["config_default_tlv"]["tlv"]);
    TEST_ASSERT_EQUAL(want.size(), n);
    TEST_ASSERT_EQUAL_MEMORY(want.data(), buf, n);
    TEST_ASSERT_TRUE(n <= CommandHistory::kMaxAck - 2);   // GET_CONFIG ACK fits the history
    TEST_ASSERT_EQUAL(0u, serialize_config_tlv(c, buf, 10));
}

void test_config_apply_and_atomicity() {
    NodeConfig c = default_config(kMac);
    auto setc = hex(vec("valid", "cmd_set_config_unconfigured")["command"]["args"]);
    uint32_t changed = 0;
    TEST_ASSERT_EQUAL(int(AckStatus::Ok), int(apply_config_tlv(setc.data(), setc.size(), Variant::WithStrips, &c, &changed)));
    TEST_ASSERT_EQUAL_UINT16(5, c.universe);
    TEST_ASSERT_EQUAL_UINT16(10, c.start_address);
    TEST_ASSERT_EQUAL_STRING("lyre-1", c.name);
    TEST_ASSERT_EQUAL_HEX32((1u << key::kUniverse) | (1u << key::kStartAddress) | (1u << key::kName), changed);

    // one bad item: nothing applied
    const uint8_t bad[] = {key::kUniverse, 2, 9, 0, key::kRadioChannel, 1, 14};
    NodeConfig before = c;
    TEST_ASSERT_EQUAL(int(AckStatus::InvalidArg), int(apply_config_tlv(bad, sizeof bad, Variant::WithStrips, &c, nullptr)));
    TEST_ASSERT_EQUAL_MEMORY(&before, &c, sizeof c);
    const uint8_t unknown[] = {0x42, 1, 0};
    TEST_ASSERT_EQUAL(int(AckStatus::InvalidArg), int(apply_config_tlv(unknown, sizeof unknown, Variant::WithStrips, &c, nullptr)));
    const uint8_t truncated[] = {key::kUniverse, 2, 9};
    TEST_ASSERT_EQUAL(int(AckStatus::InvalidArg), int(apply_config_tlv(truncated, sizeof truncated, Variant::WithStrips, &c, nullptr)));
    const uint8_t wrong_len[] = {key::kUniverse, 1, 9};
    TEST_ASSERT_EQUAL(int(AckStatus::InvalidArg), int(apply_config_tlv(wrong_len, sizeof wrong_len, Variant::WithStrips, &c, nullptr)));
    const uint8_t bad_utf8[] = {key::kName, 2, 0xC3, 0x28};
    TEST_ASSERT_EQUAL(int(AckStatus::InvalidArg), int(apply_config_tlv(bad_utf8, sizeof bad_utf8, Variant::WithStrips, &c, nullptr)));
    const uint8_t utf8[] = {key::kName, 7, 'f', 'a', 0xC3, 0xA7, 'a', 'd', 'e'};   // "façade"
    TEST_ASSERT_EQUAL(int(AckStatus::Ok), int(apply_config_tlv(utf8, sizeof utf8, Variant::WithStrips, &c, nullptr)));
    // secrets are write-only
    uint8_t keyv[34] = {key::kNetKey, 32};
    TEST_ASSERT_EQUAL(int(AckStatus::Ok), int(apply_config_tlv(keyv, sizeof keyv, Variant::WithStrips, &c, nullptr)));
    TEST_ASSERT_TRUE(c.has_net_key);
    uint8_t buf[200];
    size_t n = serialize_config_tlv(c, buf, sizeof buf);
    bool secret = false;
    tlv_for_each(buf, n, [&](uint8_t k, const uint8_t*, uint8_t) { secret |= k == key::kNetKey || k == key::kMaintPassword; });
    TEST_ASSERT_FALSE(secret);
}

void test_config_footprint_limits() {
    NodeConfig c = default_config(kMac);
    c.pwm_mode = 1;   // relay + 8 PWM bytes = 9 channels
    Footprint f = footprint(c, Variant::WithStrips);
    TEST_ASSERT_EQUAL(9, f.size);
    TEST_ASSERT_EQUAL(0, f.relay_slot);
    TEST_ASSERT_EQUAL(1, f.pwm_first);
    const uint8_t ok[] = {key::kStartAddress, 2, 0xF8, 0x01};    // 504: 504..512
    TEST_ASSERT_EQUAL(int(AckStatus::Ok), int(apply_config_tlv(ok, sizeof ok, Variant::WithStrips, &c, nullptr)));
    const uint8_t over[] = {key::kStartAddress, 2, 0xF9, 0x01};  // 505: beyond 512
    TEST_ASSERT_EQUAL(int(AckStatus::InvalidArg), int(apply_config_tlv(over, sizeof over, Variant::WithStrips, &c, nullptr)));
    TEST_ASSERT_EQUAL(int(AckStatus::Ok), int(apply_config_tlv(over, sizeof over, Variant::FixtureOnly, &c, nullptr)));
    c.relay_dmx = 0;
    c.pwm_mode = 0;
    c.start_address = 1;
    f = footprint(c, Variant::FixtureOnly);
    TEST_ASSERT_EQUAL(0, f.size);
    TEST_ASSERT_EQUAL(-1, f.relay_slot);

    // PWM values from a frame: 8 bit scaled x257, 16 bit MSB then LSB
    uint8_t frame[16] = {200, 1, 2, 3, 255, 0x12, 0x34};
    c.relay_dmx = 1;
    f = footprint(c, Variant::WithStrips);
    TEST_ASSERT_EQUAL_UINT16(1 * 257, pwm_value(f, frame, 16, 0));
    TEST_ASSERT_EQUAL_UINT16(65535, pwm_value(f, frame, 16, 3));
    c.pwm_mode = 1;
    f = footprint(c, Variant::WithStrips);
    TEST_ASSERT_EQUAL_UINT16(0x0102, pwm_value(f, frame, 16, 0));
    TEST_ASSERT_EQUAL_UINT16(0x0000, pwm_value(f, frame, 4, 2));   // beyond the frame: 0
}

// --- Reassembly -------------------------------------------------------------------------
struct Frag {
    uint16_t off, len;
    uint8_t flags;
    std::vector<uint8_t> data;
};
static std::vector<Frag> fragments() {
    std::vector<Frag> out;
    for (JsonVariant pv : V["fragmented"]["packets"].as<JsonArray>()) {
        auto p = hex(pv.as<const char*>());
        Header h;
        TEST_ASSERT_EQUAL_STRING("ok", reject_name(validate(p.data(), p.size(), V["net_id"], &h)));
        out.push_back({h.offset, h.length, h.flags, std::vector<uint8_t>(p.begin() + kHeaderSize, p.end())});
    }
    return out;
}

void test_reassembly_in_order() {
    auto fr = fragments();
    auto want = hex(V["fragmented"]["frame"]);
    Reassembler r;
    TEST_ASSERT_EQUAL(int(Reassembler::Result::None), int(r.feed(7, fr[0].off, fr[0].len, fr[0].flags, fr[0].data.data())));
    TEST_ASSERT_EQUAL(int(Reassembler::Result::None), int(r.feed(7, fr[1].off, fr[1].len, fr[1].flags, fr[1].data.data())));
    TEST_ASSERT_EQUAL(int(Reassembler::Result::Complete), int(r.feed(7, fr[2].off, fr[2].len, fr[2].flags, fr[2].data.data())));
    TEST_ASSERT_EQUAL(512, r.frame_len());
    TEST_ASSERT_EQUAL_MEMORY(want.data(), r.frame(), 512);
    // duplicates of a completed seq are ignored
    TEST_ASSERT_EQUAL(int(Reassembler::Result::None), int(r.feed(7, fr[2].off, fr[2].len, fr[2].flags, fr[2].data.data())));
    TEST_ASSERT_EQUAL(int(Reassembler::Result::None), int(r.feed(7, fr[0].off, fr[0].len, fr[0].flags, fr[0].data.data())));
}

void test_reassembly_loss_merges_previous_values() {
    auto fr = fragments();
    Reassembler r;
    std::vector<uint8_t> old(232, 0xAA);
    r.feed(6, 0, 232, flags::kFrag, old.data());
    r.feed(6, 232, 232, flags::kFrag, old.data());
    std::vector<uint8_t> tail(48, 0xAA);
    TEST_ASSERT_EQUAL(int(Reassembler::Result::Complete), int(r.feed(6, 464, 48, flags::kFrag | flags::kLast, tail.data())));
    // seq 7: middle fragment lost -> partial merge at LAST
    r.feed(7, fr[0].off, fr[0].len, fr[0].flags, fr[0].data.data());
    TEST_ASSERT_EQUAL(int(Reassembler::Result::Partial), int(r.feed(7, fr[2].off, fr[2].len, fr[2].flags, fr[2].data.data())));
    TEST_ASSERT_EQUAL_MEMORY(fr[0].data.data(), r.frame(), 232);
    TEST_ASSERT_EACH_EQUAL_UINT8(0xAA, r.frame() + 232, 232);   // previous values kept
    TEST_ASSERT_EQUAL_MEMORY(fr[2].data.data(), r.frame() + 464, 48);
    // the lost fragment arriving late completes the frame
    TEST_ASSERT_EQUAL(int(Reassembler::Result::Complete), int(r.feed(7, fr[1].off, fr[1].len, fr[1].flags, fr[1].data.data())));
}

void test_reassembly_out_of_order_and_new_seq() {
    auto fr = fragments();
    auto want = hex(V["fragmented"]["frame"]);
    Reassembler r;
    // LAST first, then the others: partial, then complete
    TEST_ASSERT_EQUAL(int(Reassembler::Result::Partial), int(r.feed(7, fr[2].off, fr[2].len, fr[2].flags, fr[2].data.data())));
    // a fragment that does not complete the frame is applied, output waits for the rest
    TEST_ASSERT_EQUAL(int(Reassembler::Result::None), int(r.feed(7, fr[0].off, fr[0].len, fr[0].flags, fr[0].data.data())));
    TEST_ASSERT_EQUAL(int(Reassembler::Result::Complete), int(r.feed(7, fr[1].off, fr[1].len, fr[1].flags, fr[1].data.data())));
    TEST_ASSERT_EQUAL_MEMORY(want.data(), r.frame(), 512);
    // seq 8 loses its LAST: the next seq outputs it as a partial merge
    std::vector<uint8_t> x(232, 0x55);
    TEST_ASSERT_EQUAL(int(Reassembler::Result::None), int(r.feed(8, 0, 232, flags::kFrag, x.data())));
    TEST_ASSERT_EQUAL(int(Reassembler::Result::Partial), int(r.feed(9, 0, 232, flags::kFrag, x.data())));
}

void test_reassembly_v2_zeroes_beyond_length() {
    Reassembler r;
    std::vector<uint8_t> full(512, 9);
    r.feed(1, 0, 512, flags::kLast, full.data());
    uint8_t short_frame[4] = {1, 2, 3, 4};
    TEST_ASSERT_EQUAL(int(Reassembler::Result::Complete), int(r.feed(2, 0, 4, flags::kLast, short_frame)));
    TEST_ASSERT_EQUAL(4, r.frame_len());
    TEST_ASSERT_EACH_EQUAL_UINT8(0, r.frame() + 4, 508);
}

// --- Loss counter -----------------------------------------------------------------------
void test_loss_counter_wrap_and_resync() {
    LossCounter l;
    l.on_frame(65533);
    l.on_frame(65534);
    l.on_frame(65535);
    l.on_frame(0);        // 16-bit wrap: no loss
    TEST_ASSERT_EQUAL_UINT32(0, l.lost_frames());
    l.on_frame(3);        // 1 and 2 lost
    TEST_ASSERT_EQUAL_UINT32(2, l.lost_frames());
    l.on_frame(3);        // same frame again: ignored
    TEST_ASSERT_EQUAL_UINT32(5, l.rx_frames());
    l.on_frame(5000);     // dongle restart: resync, no loss counted
    TEST_ASSERT_EQUAL_UINT32(2, l.lost_frames());
    l.on_frame(5001);
    TEST_ASSERT_EQUAL_UINT32(2, l.lost_frames());
    TEST_ASSERT_EQUAL_UINT32(7, l.rx_frames());
}

// --- Relay ------------------------------------------------------------------------------------
void test_relay_power_on_modes() {
    RelayLogic r;
    r.begin(1, false, true, 3000, 0);
    TEST_ASSERT_TRUE(r.update(0));
    TEST_ASSERT_TRUE(r.state());
    r.begin(0, true, true, 3000, 0);
    TEST_ASSERT_FALSE(r.update(0));
    TEST_ASSERT_FALSE(r.state());
    r.begin(2, true, true, 3000, 0);
    TEST_ASSERT_TRUE(r.update(0));
    TEST_ASSERT_TRUE(r.state());
}

void test_relay_dmx_level_and_deferral() {
    RelayLogic r;
    r.begin(0, false, true, 3000, 0);
    r.dmx_level(127, 0);
    TEST_ASSERT_FALSE(r.update(0));
    r.dmx_level(128, 100);
    TEST_ASSERT_TRUE(r.update(100));         // first switch is immediate
    TEST_ASSERT_TRUE(r.state());
    r.dmx_level(0, 500);
    TEST_ASSERT_FALSE(r.update(500));        // deferred, not dropped
    TEST_ASSERT_TRUE(r.pending());
    TEST_ASSERT_EQUAL_HEX8(0x05, r.heartbeat_bits());   // on + pending
    r.dmx_level(255, 1000);                  // back on before the deadline
    r.dmx_level(0, 2000);                    // and off again: the last value wins
    TEST_ASSERT_FALSE(r.update(3099));
    TEST_ASSERT_TRUE(r.update(3100));
    TEST_ASSERT_FALSE(r.state());
    // fast blinking: at most one switch per interval
    int switches = 0;
    for (uint32_t t = 3100; t < 9100; t += 50) {
        r.dmx_level((t / 50) % 2 ? 255 : 0, t);
        switches += r.update(t);
    }
    TEST_ASSERT_TRUE(switches <= 2);
    TEST_ASSERT_EQUAL_UINT32(2 + switches, r.switch_count());
}

void test_relay_priorities_and_stream_loss() {
    RelayLogic r;
    r.begin(0, false, true, 1000, 0);
    r.dmx_level(255, 0);
    TEST_ASSERT_TRUE(r.update(0));
    r.command(RelayLogic::Force::Off, 10);   // force beats DMX
    r.dmx_level(255, 1500);
    TEST_ASSERT_TRUE(r.update(1500));
    TEST_ASSERT_FALSE(r.state());
    TEST_ASSERT_EQUAL_HEX8(0x02, r.heartbeat_bits());   // off, forced, nothing pending
    r.command(RelayLogic::Force::Auto, 1600); // back to the DMX channel (255 -> on)
    TEST_ASSERT_TRUE(r.update(2600));
    TEST_ASSERT_TRUE(r.state());
    // stream loss: no more dmx_level() calls, the relay keeps its state
    for (uint32_t t = 2600; t < 20000; t += 1000) TEST_ASSERT_FALSE(r.update(t));
    TEST_ASSERT_TRUE(r.state());
    // relay_dmx = 0: the channel is ignored
    r.set_relay_dmx(false);
    r.dmx_level(0, 20000);
    TEST_ASSERT_FALSE(r.update(25000));
    TEST_ASSERT_TRUE(r.state());
}

// --- Gamma / PWM ----------------------------------------------------------------------------
void test_gamma_bounds_monotonic_linear() {
    GammaTable g;
    for (uint8_t gx : {uint8_t(10), uint8_t(22), uint8_t(30)}) {
        for (uint8_t bits : {uint8_t(12), uint8_t(14)}) {
            g.build(gx, bits);
            uint32_t max = (1u << bits) - 1;
            TEST_ASSERT_EQUAL_UINT32(0, g.lookup8(0));
            TEST_ASSERT_EQUAL_UINT32(max, g.lookup8(255));
            TEST_ASSERT_EQUAL_UINT32(0, g.lookup16(0));
            TEST_ASSERT_EQUAL_UINT32(max, g.lookup16(65535));
            for (int i = 1; i < 256; ++i) TEST_ASSERT_TRUE(g.lookup8(uint8_t(i)) >= g.lookup8(uint8_t(i - 1)));
            uint32_t prev = 0;
            for (uint32_t v = 0; v <= 65535; v += 17) {
                uint32_t d = g.lookup16(uint16_t(v));
                TEST_ASSERT_TRUE(d >= prev);
                prev = d;
            }
            if (gx == 10)
                for (int i = 0; i < 256; ++i)
                    TEST_ASSERT_UINT32_WITHIN(1, (uint32_t(i) * max + 127) / 255, g.lookup8(uint8_t(i)));
        }
    }
    g.build(22, 14);
    TEST_ASSERT_TRUE(g.lookup8(128) < (1u << 14) / 4);   // gamma 2.2 at mid-scale ~ 22 %
}

void test_pwm_resolution() {
    TEST_ASSERT_EQUAL_UINT8(14, pwm_resolution_bits(4882));
    TEST_ASSERT_EQUAL_UINT8(12, pwm_resolution_bits(19531));
    TEST_ASSERT_EQUAL_UINT8(14, pwm_resolution_bits(1000));
    TEST_ASSERT_EQUAL_UINT8(13, pwm_resolution_bits(9000));
}

// --- Output cadence ---------------------------------------------------------------------------
void test_output_cadence() {
    OutputCadence c(10, 22727);
    TEST_ASSERT_FALSE(c.due(0));
    c.on_new_data();
    TEST_ASSERT_TRUE(c.due(0));               // new data: immediately
    c.sent(0);
    c.on_new_data();
    TEST_ASSERT_FALSE(c.due(5000));           // < 10 ms: merged
    TEST_ASSERT_TRUE(c.due(10000));
    c.sent(10000);
    TEST_ASSERT_FALSE(c.due(30000));          // nothing new: refresh at 22.7 ms
    TEST_ASSERT_TRUE(c.due(32727));
    TEST_ASSERT_EQUAL_UINT32(22760, dmx_frame_us(512));   // 22.7 ms (SPEC 5.1)
    TEST_ASSERT_EQUAL_UINT32(1288, dmx_frame_us(24));
}

int main() {
    std::ifstream f(VECTORS_PATH);
    std::stringstream ss;
    ss << f.rdbuf();
    if (deserializeJson(V, ss.str())) return 2;
    UNITY_BEGIN();
    RUN_TEST(test_crc_check_value);
    RUN_TEST(test_valid_packets_decode);
    RUN_TEST(test_invalid_packets_rejected_in_order);
    RUN_TEST(test_build_packet_matches_vectors);
    RUN_TEST(test_unconfigured_node_accepts_command_and_beacon_only);
    RUN_TEST(test_heartbeat_codec);
    RUN_TEST(test_beacon_and_command_codec);
    RUN_TEST(test_sha256_and_hmac_vectors);
    RUN_TEST(test_command_auth);
    RUN_TEST(test_command_history_idempotence);
    RUN_TEST(test_cobs_vectors);
    RUN_TEST(test_config_defaults_serialize_like_python);
    RUN_TEST(test_config_apply_and_atomicity);
    RUN_TEST(test_config_footprint_limits);
    RUN_TEST(test_reassembly_in_order);
    RUN_TEST(test_reassembly_loss_merges_previous_values);
    RUN_TEST(test_reassembly_out_of_order_and_new_seq);
    RUN_TEST(test_reassembly_v2_zeroes_beyond_length);
    RUN_TEST(test_loss_counter_wrap_and_resync);
    RUN_TEST(test_relay_power_on_modes);
    RUN_TEST(test_relay_dmx_level_and_deferral);
    RUN_TEST(test_relay_priorities_and_stream_loss);
    RUN_TEST(test_gamma_bounds_monotonic_linear);
    RUN_TEST(test_pwm_resolution);
    RUN_TEST(test_output_cadence);
    return UNITY_END();
}
